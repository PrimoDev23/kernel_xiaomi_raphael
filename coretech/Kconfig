## coretech/Kconfig
```kconfig
config OPCHAIN
	default n
	bool "Oneplus CoreTech helper, used for opchain module"
config HOUSTON
	default n
	bool "to collect system-wide and pmu data"
	help
	 Realtime temperature monitor
config CONTROL_CENTER
	default n
	bool "control center"
config AIGOV
	default y
	bool "A governor which using ai predicted info as input"
```
